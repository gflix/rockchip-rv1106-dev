// SPDX-License-Identifier: (GPL-2.0+ OR MIT)
/*
 * RV1106 EVB - minimal bringup board DTS.
 *
 * Copyright (c) 2026 Felix Mellmann <flix@benfm.de>
 */

/dts-v1/;

#include "rv1106.dtsi"

/ {
        model = "Rockchip RV1106 EVB";
        compatible = "rockchip,rv1106-evb", "rockchip,rv1106";

        memory@0 {
                device_type = "memory";
                reg = <0x00000000 0x10000000>; /* 256 MiB */
        };

        chosen {
                stdout-path = "serial2:115200n8";
        };
};

&uart2 {
        status = "okay";
};
