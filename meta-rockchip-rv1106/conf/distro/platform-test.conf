## meta-rockchip-rv1106/conf/distro/platform-test.conf
```bitbake
DISTROOVERRIDES =. "poky:"
PACKAGE_CLASSES ?= "package_ipk"

require conf/distro/poky.conf

DISTRO = "platform-test"

DISTRO_FEATURES:remove = "\
    acl \
    alsa \
    bluetooth \
    debuginfod \
    wifi \
    xattr \
    nfs \
    zeroconf \
    pci \
    3g \
    nfc \
    x11 \
    seccomp \
    pulseaudio \
    gobject-introspection-data \
    ldconfig \
    opengl \
    ptest \
    multiarch \
    wayland \
    vulkan \
"

OLDEST_KERNEL = "5.10"
```

## meta-rockchip-rv1106/conf/machine/rockchip-rv1106.conf
```bitbake
require conf/machine/include/arm/armv7a/tune-cortexa7.inc

UBOOT_MACHINE = "rv1106-evb_defconfig"
UBOOT_SUFFIX = "img"
UBOOT_ENTRYPOINT ?= "0x00008000"

PREFERRED_PROVIDER_virtual/kernel ?= "linux-rockchip"
PREFERRED_PROVIDER_virtual/dtb = "devicetree-rockchip-rv1106"

INITRAMFS_IMAGE = "platform-test-image"

MACHINE_FEATURES:remove = "\
    rtc \
"

SERIAL_CONSOLES = "115200;ttyFIQ0"
USE_VT = "0"
```

## meta-rockchip-rv1106/files/wic/rockchip-rv1106.wks
```
# Disk layout for Rockchip RV1106
# idbloader at 32K, u-boot at 384K

part idbloader --source rawcopy --sourceparams="file=idbloader.img" --ondisk mmcblk --no-table --align 32
part u-boot --source rawcopy --sourceparams="file=u-boot.img" --ondisk mmcblk --no-table --align 384
part fitimage --source rawcopy --sourceparams="file=fitImage" --ondisk mmcblk --no-table --align 2048
```
