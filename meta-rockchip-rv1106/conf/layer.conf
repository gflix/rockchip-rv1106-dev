## meta-rockchip-rv1106/conf/layer.conf
```bitbake
# We have a conf and classes directory, add to BBPATH
BBPATH .= ":${LAYERDIR}"

# We have recipes-* directories, add to BBFILES
BBFILES += "${LAYERDIR}/recipes-*/*/*.bb \
            ${LAYERDIR}/recipes-*/*/*.bbappend"

BBFILE_COLLECTIONS += "rockchip-rv1106"
BBFILE_PATTERN_rockchip-rv1106 = "^${LAYERDIR}/"
BBFILE_PRIORITY_rockchip-rv1106 = "6"

LAYERDEPENDS_rockchip-rv1106 = "core"
LAYERSERIES_COMPAT_rockchip-rv1106 = "scarthgap"
```
